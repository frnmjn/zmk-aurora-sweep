#include <behaviors.dtsi>
#include <dt-bindings/zmk/keys.h>
#include <dt-bindings/zmk/bt.h>


#include "34_labels.h"
#include "italian_keys.h"

/* Global settings */

#define TAPPING_TERM 200
#define TAPPING_TERM_RING 250
#define TAPPING_TERM_PINKY 300
#define QUICK_TAP_TERM 300

&lt {
    tapping-term-ms = <TAPPING_TERM>;
    quick-tap-ms = <QUICK_TAP_TERM>;
};

&sk {
    ignore-modifiers;
    release-after-ms = <3000>;
};
